## config/boards/shields/obsidian/Kconfig.defconfig
```kconfig
# Copyright (c) 2020 The ZMK Contributors
# SPDX-License-Identifier: MIT

# config ZMK_BLE
# 	default y

# config ZMK_USB
# 	default y

if SHIELD_OBSIDIAN_LEFT

config ZMK_KEYBOARD_NAME
	default "Obsidian"

config ZMK_SPLIT_ROLE_CENTRAL
	default y

endif

if SHIELD_OBSIDIAN_LEFT || SHIELD_OBSIDIAN_RIGHT

config ZMK_SPLIT
	default y

endif
```

## config/boards/shields/obsidian/Kconfig.shield
```kconfig
config SHIELD_OBSIDIAN_LEFT
    def_bool $(shields_list_contains,obsidian_left)

config SHIELD_OBSIDIAN_RIGHT
    def_bool $(shields_list_contains,obsidian_right)
```
